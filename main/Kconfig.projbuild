## main/Kconfig.projbuild
```kconfig
menu "PSI3541 Configurations"

    config ESP_WIFI_SSID
        string "WiFi SSID"
        default "myssid"
        help
            SSID (network name) for the example to connect to.

    config ESP_WIFI_PASSWORD
        string "WiFi Password"
        default "mypassword"
        help
            WiFi password (WPA or WPA2) for the example to use.

    config ESP_MAXIMUM_RETRY
        int "Maximum retry"
        default 5
        help
            Set the Maximum retry to avoid station reconnecting to the AP unlimited when the AP is really inexistent.

    config BROKER_URI
        string "MQTT Broker URI"
        default "xxxxxxxxxxxxxx-xxx.iot.xx-xxxx-x.amazonaws.com"
        help
            The hostname or IP address of the MQTT broker.

    config BROKER_PORT
        int "MQTT Broker Port"
        default 8883
        help
            The port number of the MQTT broker.

endmenu
```
